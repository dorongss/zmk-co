&pro_micro_i2c {
    status = "okay";

    trackball: trackball@a {
        compatible = "pimoroni,trackball";
        reg = <0x0a>;
        
        /* INT(인터럽트) 선이 nice!nano의 D4 핀에 납땜된 경우입니다. */
        /* 만약 다른 곳에 납땜하셨다면 이 숫자(4)를 바꿔주셔야 합니다! */
        int-gpios = <&pro_micro 4 (GPIO_ACTIVE_LOW | GPIO_PULL_UP)>; 
    };
};
